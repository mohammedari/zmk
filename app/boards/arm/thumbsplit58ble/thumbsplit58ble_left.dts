/*
 * Copyright (c) 2021 Kazuyuki Arimatsu
 *
 * SPDX-License-Identifier: MIT
 */

#include "thumbsplit58ble.dtsi"

conn_io: &conn_io_left {};

&spi1 {
	mosi-pin = <41>; //P1.09
	// Unused pins, needed for SPI definition, but not used by the ws2812 driver itself.
	sck-pin = <5>;
	miso-pin = <7>;
};

&led_strip {
	chain-length = <28>;
};