/*
 * Copyright (c) 2021 Kazuyuki Arimatsu
 *
 * SPDX-License-Identifier: MIT
 */

/ {
	conn_io_right: connector_right {
		#gpio-cells = <2>;
		gpio-map-mask = <0xffffffff 0xffffffc0>;
		gpio-map-pass-thru = <0 0x3f>;
		gpio-map
			= < 0 0 &gpio0 13 0>
			, < 1 0 &gpio0 31 0>
			, < 2 0 &gpio0 26 0>
			, < 3 0 &gpio0  6 0>
			, < 4 0 &gpio0  8 0>
			, < 5 0 &gpio1  9 0>
			, < 6 0 &gpio0 12 0>
			, < 7 0 &gpio0 15 0>
			, < 8 0 &gpio0 22 0>
			, < 9 0 &gpio0 24 0>
			, <10 0 &gpio0  2 0>
			, <11 0 &gpio1  0 0>	
			, <12 0 &gpio1 15 0>
			;
	};

	conn_io_left: connector_left {
		#gpio-cells = <2>;
		gpio-map-mask = <0xffffffff 0xffffffc0>;
		gpio-map-pass-thru = <0 0x3f>;
		gpio-map
			= < 0 0 &gpio0 12 0>
			, < 1 0 &gpio0  8 0>
			, < 2 0 &gpio0  6 0>
			, < 3 0 &gpio0 26 0>
			, < 4 0 &gpio0 31 0>
			, < 5 0 &gpio0 29 0>
			, < 6 0 &gpio0  2 0>
			, < 7 0 &gpio1 15 0>
			, < 8 0 &gpio1  0 0>
			, < 9 0 &gpio0 24 0>
			, <10 0 &gpio0 22 0>
			, <11 0 &gpio0 15 0>	
			, <12 0 &gpio0 13 0>
			;
	};

	// Workaround to support settings_reset shield
	pro_micro_d: connector_d {
		compatible = "arduino-pro-micro";
		#gpio-cells = <2>;
		gpio-map-mask = <0xffffffff 0xffffffc0>;
		gpio-map-pass-thru = <0 0x3f>;
		gpio-map
			= <4 0 &gpio0 8 0>		// IO1
			;
	};
};
