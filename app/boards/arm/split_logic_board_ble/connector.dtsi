/*
 * Copyright (c) 2021 Kazuyuki Arimatsu
 *
 * SPDX-License-Identifier: MIT
 */

/ {
	connector0: connector {
		#gpio-cells = <2>;
		gpio-map-mask = <0xffffffff 0xffffffc0>;
		gpio-map-pass-thru = <0 0x3f>;
		gpio-map
			= <7  0 &gpio0 29 0>
			, <8  0 &gpio0 31 0>
			, <9  0 &gpio0 26 0>
			, <10 0 &gpio0 4  0>
			, <11 0 &gpio0 6  0>
			, <12 0 &gpio0 8  0>
			, <13 0 &gpio1 9  0>
			, <14 0 &gpio0 12 0>
			, <15 0 &gpio0 13 0>
			, <16 0 &gpio0 15 0>
			, <17 0 &gpio0 20 0>
			, <18 0 &gpio0 22 0>
			, <19 0 &gpio0 24 0>	
			, <20 0 &gpio1 0  0>
			;
	};
};
